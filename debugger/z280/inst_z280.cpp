#include "inst_z280.h"

#include "signals_z280.h"

namespace debugger {
namespace z280 {

namespace {

// From z280-PAGExx.txt (measured with tools/cycles_z280.py), in
// debugger/match_legend.md's tokens:
//   awk -f inst_z280.awk z280-PAGE{00,CB,ED,DD,FD,DDCB,FDCB,DDED,FDED}.txt
// clang-format off
// BEGIN GENERATED
// Generated by: gawk -f inst_z280.awk z280-PAGE00.txt z280-PAGECB.txt
//     z280-PAGEED.txt z280-PAGEDD.txt z280-PAGEFD.txt z280-PAGEDDCB.txt
//     z280-PAGEFDCB.txt z280-PAGEDDED.txt z280-PAGEFDED.txt | clang-format
constexpr const char *const SEQUENCES[/*seq*/] = {
        "",                  //   0
        "1N",                //   1
        "122N",              //   2
        "1~WN",              //   3
        "12N",               //   4
        "1~RN",              //   5
        "12~J@12N",          //   6
        "12~J",              //   7
        "122~WwN",           //   8
        "122~RrN",           //   9
        "122~WN",            //  10
        "1~RWN",             //  11
        "12~WN",             //  12
        "122~RN",            //  13
        "1~RrP@1N",          //  14
        "1~RrN",             //  15
        "122~J@122N",        //  16
        "122~J",             //  17
        "122~WwJ@122N",      //  18
        "1~~WwN",            //  19
        "1~WwJ",             //  20
        "1~RrP",             //  21
        "122~WwJ",           //  22
        "12~~ON",            //  23
        "12~~IN",            //  24
        "1~RrWwN",           //  25
        "1~?",               //  26
        "12~RWN",            //  27
        "12~RN",             //  28
        "1222N",             //  29
        "1222~WN",           //  30
        "1222~RrN",          //  31
        "1222~WwN",          //  32
        "12~RrN",            //  33
        "12~~WN",            //  34
        "12~~WwN",           //  35
        "12~WwN",            //  36
        "12~R~WN",           //  37
        "12~IN",             //  38
        "12~ON",             //  39
        "12~RrP",            //  40
        "12~RrRrP",          //  41
        "1222~WwWwWwRrRrP",  //  42
        "12~II~WwN",         //  43
        "12~Rr~OON",         //  44
        "12~{IIW+2w}N",      //  45
        "12~{R+2rOO}N",      //  46
        "12~{IIW-2w}N",      //  47
        "12~{R-2rOO}N",      //  48
        "12~I~WN",           //  49
        "12~R~ON",           //  50
        "12~{R+1W+1}N",      //  51
        "12~{R+1}N",         //  52
        "12~{IW+1}N",        //  53
        "12~{R+1O}N",        //  54
        "12~IIN",            //  55
        "12~{R-1W-1}N",      //  56
        "12~{R-1}N",         //  57
        "12~{IW-1}N",        //  58
        "12~{R-1O}N",        //  59
        "12~OON",            //  60
        "12~RrWwN",          //  61
        "1222~RWN",          //  62
        "12222~WN",          //  63
        "122~~WN",           //  64
        "122222~WwN",        //  65
        "1222~RrWwN",        //  66
        "122~RWN",           //  67
        "1222~RN",           //  68
        "12~Rr~WwN",         //  69
        "12~?@12N",          //  70
        "12~Ww?@12N",        //  71
        "12~Ww?",            //  72
        "1222~Rr~WwN",       //  73
        "12~?",              //  74
        "1222~Rr~~WwN",      //  75
        "1222~J@1222N",      //  76
        "1222~J",            //  77
        "1222~WwJ@1222N",    //  78
        "1222~WwJ",          //  79
        "1222~~WwN",         //  80
        "12222N",            //  81
        "12222~RrN",         //  82
        "12222~WwN",         //  83
        "12222~R~WN",        //  84
        "122~~WwN",          //  85
        "122~R~~WN",         //  86
        "1222~R~WN",         //  87
        "12222~I~WN",        //  88
        "12222~R~ON",        //  89
        "122~I~WN",          //  90
        "122~R~ON",          //  91
        "122~IN",            //  92
        "122~ON",            //  93
        "12222~RN",          //  94
};

constexpr uint8_t PAGE00_TABLE[] = {
        1,   // 00: NOP     -                  1N
        2,   // 01: LD      BC,0302H           122N
        3,   // 02: LD      (BC),A             1~WN
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        20,  // FF: RST     38H                1~WwJ
};

constexpr uint8_t PAGECB_TABLE[] = {
        4,   // 00: RLC     B                  12N
        4,   // 01: RLC     C                  12N
        4,   // 02: RLC     D                  12N
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        4,   // FF: SET     7,A                12N
};

constexpr uint8_t PAGEED_TABLE[] = {
        0,   // 00
        0,   // 01
        29,  // 02: LDA     HL,(SP+0403H)      1222N
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        0,   // FF
};

constexpr uint8_t PAGEDD_TABLE[] = {
        0,   // 00
        32,  // 01: LDW     (HL),0302H         1222~WwN
        0,   // 02
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        0,   // FF
};

constexpr uint8_t PAGEFD_TABLE[] = {
        0,   // 00
        0,   // 01
        0,   // 02
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        0,   // FF
};

constexpr uint8_t PAGEDDCB_TABLE[] = {
        0,   // 00
        0,   // 01
        0,   // 02
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        0,   // FF
};

constexpr uint8_t PAGEFDCB_TABLE[] = {
        0,   // 00
        0,   // 01
        0,   // 02
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        0,   // FF
};

constexpr uint8_t PAGEDDED_TABLE[] = {
        0,   // 00
        0,   // 01
        81,  // 02: LDA     IX,(SP+0403H)      12222N
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        0,   // FF
};

constexpr uint8_t PAGEFDED_TABLE[] = {
        0,   // 00
        0,   // 01
        81,  // 02: LDA     IY,(SP+0403H)      12222N
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        0,   // FF
};
// END GENERATED
// clang-format on

// An interrupt or a trap, where the queue may have fetched ahead: an
// acknowledge but for #NMI's and a trap's, the pushes (the PC; in mode 3
// the MSR and identifier too), the table reads (modes 2 and 3), then the
// vector's fetch.
constexpr const char INTERRUPT[] =
        "~!WwWwWwRrRr?@~!WwWwWwRr?@~!WwWwWw?@~!WwWwRrRr?@~!WwWwRr?@"
        "~!WwWw?@~!WwRrRr?@~!WwRr?@~!Ww?@~WwWwWwRrRr?@~WwWwWwRr?@"
        "~WwWwWw?@~WwWwRrRr?@~WwWwRr?@~WwWw?@~WwRrRr?@~WwRr?@~Ww?";

// The row of the instruction at |pc|: its page and opcode too.
const uint8_t *row(
        uint32_t pc, const MatchMemory &mems, uint8_t &page, uint8_t &opc) {
    const uint8_t b0 = mems.read_byte(pc);
    page = 0;
    if (b0 == 0xCB) {
        page = b0;
        opc = mems.read_byte(pc + 1);
        return &PAGECB_TABLE[opc];
    }
    if (b0 == 0xED) {
        page = b0;
        opc = mems.read_byte(pc + 1);
        return &PAGEED_TABLE[opc];
    }
    if (b0 == 0xDD || b0 == 0xFD) {
        const uint8_t b1 = mems.read_byte(pc + 1);
        if (b1 == 0xCB) {  // the displacement before the opcode
            opc = mems.read_byte(pc + 3);
            return b0 == 0xDD ? &PAGEDDCB_TABLE[opc] : &PAGEFDCB_TABLE[opc];
        }
        if (b1 == 0xED) {
            opc = mems.read_byte(pc + 2);
            return b0 == 0xDD ? &PAGEDDED_TABLE[opc] : &PAGEFDED_TABLE[opc];
        }
        page = b0;
        opc = b1;
        return b0 == 0xDD ? &PAGEDD_TABLE[b1] : &PAGEFD_TABLE[b1];
    }
    opc = b0;
    return &PAGE00_TABLE[b0];
}

// JP's, CALL's and their conditional ones' opcodes.
bool absolute(uint8_t opc) {
    const auto group = opc & 0xC7;
    return group == 0xC2 || group == 0xC4 || opc == 0xC3 || opc == 0xCD;
}

}  // namespace

MatchWalker::Kind InstZ280::cycleKind(const SignalsImpl *impl) const {
    const auto s = static_cast<const Signals *>(impl);
    if (s->memReq())
        return s->read() ? MatchWalker::K_READ : MatchWalker::K_WRITE;
    if (s->ioReq())
        return s->read() ? MatchWalker::K_IO_READ : MatchWalker::K_IO_WRITE;
    if (s->intAck() || s->nmiAck())
        return MatchWalker::K_ACK;
    return MatchWalker::K_NONE;
}

// J goes to nn, a JR's or DJNZ's to the next + disp, the FD page's to the
// next + disp16, RST's to its opcode & 38H.
bool InstZ280::decode(uint32_t pc, MatchWalker::Decoded &inst) const {
    pc &= 0xFFFF;
    uint8_t page, opc;
    const auto seq = SEQUENCES[*row(pc, *_mems, page, opc)];
    if (*seq == 0)
        return false;
    inst.pc = pc;
    inst.seq = seq;
    inst.length = MatchWalker::instructionBytes(seq);
    auto read = [&](uint32_t addr) { return _mems->read_byte(addr & 0xFFFF); };
    const auto next = pc + inst.length;
    const uint16_t operand = read(next - 2) | read(next - 1) << 8;
    inst.hasEa = false;
    inst.hasTarget = true;
    if ((page == 0 && (opc & 0xC7) == 0 && opc >= 0x10) ||
            (page == 0xDD && opc == 0x20)) {
        inst.target = next + static_cast<int8_t>(read(next - 1));
    } else if (page == 0 && absolute(opc)) {
        inst.target = operand;
    } else if (page == 0 && (opc & 0xC7) == 0xC7) {
        inst.target = opc & 0x38;
    } else if (page == 0xFD && absolute(opc)) {
        inst.target = next + static_cast<int16_t>(operand);
    } else {
        inst.hasTarget = false;
    }
    inst.target &= 0xFFFF;
    return true;
}

uint_fast8_t InstZ280::dataBytes(const SignalsImpl *s) const {
    return static_cast<const Signals *>(s)->wordAccess() ? 2 : 1;
}

// A word's even byte rides the high lane, as a lone byte at an even
// address does (13.5.1.1).
uint8_t InstZ280::dataByte(const SignalsImpl *impl, uint_fast8_t k) const {
    const auto s = static_cast<const Signals *>(impl);
    const auto odd = s->wordAccess() ? k != 0 : (s->addr & 1) != 0;
    return odd ? s->data & 0xFF : s->data >> 8;
}

// The MMU maps a logical page: only the offset in it is the same.
bool InstZ280::sameAddress(uint32_t bus, uint32_t addr) const {
    return (bus & 0xFFF) == (addr & 0xFFF);
}

// An interrupt pushes where the CPU would have gone on, a trap the
// instruction it aborts.
bool InstZ280::pushesPc(
        const SignalsImpl *impl, uint32_t next, uint32_t last) const {
    const auto s = static_cast<const Signals *>(impl);
    const uint16_t pushed = (s->data << 8) | (s->data >> 8);
    return s->wordAccess() &&
           (sameAddress(pushed, next) || sameAddress(pushed, last));
}

#ifndef ARDUINO
std::vector<const char *> InstZ280::sequences() {
    return std::vector<const char *>(
            std::begin(SEQUENCES), std::end(SEQUENCES));
}

std::vector<const char *> InstZ280::interrupts() {
    return {INTERRUPT};
}
#endif

const char *InstZ280::interruptSequence() const {
    return INTERRUPT;
}

void InstZ280::markCycle(
        SignalsImpl *impl, MatchWalker::Role role, uint_fast8_t) const {
    const auto s = static_cast<Signals *>(impl);
    switch (role) {
    case MatchWalker::R_FETCH:
        s->markFetch();
        break;
    case MatchWalker::R_BYTE:
        s->markByte();
        break;
    case MatchWalker::R_DATA:
        s->markOperand();
        break;
    default:
        s->clearMark();
        break;
    }
}

Signals *InstZ280::findFetch(
        Signals *begin, const Signals *end, const Memory &mems, uint32_t pc) {
    const InstZ280 arch(&mems);
    auto &walker = MatchWalker::shared();
    if (!walker.walk(arch, begin, end, pc))
        return begin->next(begin->diff(end));
    return begin->next(walker.start());
}

}  // namespace z280
}  // namespace debugger

// Local Variables:
// mode: c++
// c-basic-offset: 4
// tab-width: 4
// End:
// vim: set ft=cpp et ts=4 sw=4:
