#include "inst_z380.h"

#include "signals_z380.h"

namespace debugger {
namespace z380 {

namespace {

// From z380-PAGExx.txt (tools/derive_tables.py writes them):
//   gawk -f inst_z380.awk z380-PAGE{00,CB,ED,EDCB,DD,FD,DDCB,FDCB}.txt
// clang-format off
// BEGIN GENERATED
// Generated by: gawk -f inst_z380.awk z380-PAGE00.txt z380-PAGECB.txt
//     z380-PAGEED.txt z380-PAGEEDCB.txt z380-PAGEDD.txt z380-PAGEFD.txt
//     z380-PAGEDDCB.txt z380-PAGEFDCB.txt | clang-format
constexpr const char *const SEQUENCES[/*seq*/] = {
        "",                                            //   0
        "1~N",                                         //   1
        "1aa~N",                                       //   2
        "1~[W]N",                                      //   3
        "12~N",                                        //   4
        "1~[R]N",                                      //   5
        "12~[J]@12~N",                                 //   6
        "12~[J]",                                      //   7
        "1aa~[Ww]N/1aa~[Wwww]N/",                      //   8
        "1aa~[Rr]N/1aa~[Rrrr]N/",                      //   9
        "1aa~[W]N",                                    //  10
        "1~[RW]N",                                     //  11
        "12~[W]N",                                     //  12
        "1aa~[R]N",                                    //  13
        "1~{h}N",                                      //  14
        "1~[Rr?]@1~N//1~[Rrrr?]@1~N",                  //  15
        "1~[Rr]N/1~[Rrrr]N/",                          //  16
        "1aa~[J]@1aa~N",                               //  17
        "1aa~[J]",                                     //  18
        "1aa~[WwJ]@1aa~N//1aa~[WwwwJ]@1aa~N",          //  19
        "1~[Ww]N/1~[Wwww]N/",                          //  20
        "1~[WwJ]//1~[WwwwJ]",                          //  21
        "1~[Rr?]//1~[Rrrr?]",                          //  22
        "1aa~[WwJ]//1aa~[WwwwJ]",                      //  23
        "12~[O]N",                                     //  24
        "12~[I]N",                                     //  25
        "1~[RrWw]N/1~[RrrrWwww]N/",                    //  26
        "1~[?]",                                       //  27
        "1~[Rr]N",                                     //  28
        "12~[RW]N",                                    //  29
        "12~[R]N",                                     //  30
        "122~N",                                       //  31
        "12aa~[Ww]N/12aa~[Wwww]N/",                    //  32
        "122~[I]N",                                    //  33
        "12~[Rr?]//12~[Rrrr?]",                        //  34
        "12aa~[Rr]N/12aa~[Rrrr]N/",                    //  35
        "12~[RrII?]//12~[RrrrII?]",                    //  36
        "122~[O]N",                                    //  37
        "12~{h}N",                                     //  38
        "12aa~N",                                      //  39
        "1222~N",                                      //  40
        "12~{R+1}N",                                   //  41
        "12~{R-1}N",                                   //  42
        "12~[WI]N",                                    //  43
        "12~[RO]N",                                    //  44
        "12~{R+1W+1}N",                                //  45
        "12~{I.W+1}N",                                 //  46
        "12~{R+1O.}N",                                 //  47
        "12~{R-1W-1}N",                                //  48
        "12~{I.W-1}N",                                 //  49
        "12~{R-1O.}N",                                 //  50
        "12~[Rr]N/12~[Rrrr]N/",                        //  51
        "122~[WwJ]@122~N//122~[WwwwJ]@122~N",          //  52
        "12~[Ww]N/12~[Wwww]N/",                        //  53
        "12aa~[Rr]N",                                  //  54
        "122~[WwJ]//122~[WwwwJ]",                      //  55
        "12aa~[O]N",                                   //  56
        "12aa~[I]N",                                   //  57
        "12~[RrWw]N",                                  //  58
        "12~[WwI]N",                                   //  59
        "12~[RrO]N",                                   //  60
        "12~{R+2rW+2w}N",                              //  61
        "12~{I.W+2w}N",                                //  62
        "12~{R+2rO.}N",                                //  63
        "12~{R-2rW-2w}N",                              //  64
        "12~{I.W-2w}N",                                //  65
        "12~{R-2rO.}N",                                //  66
        "122~[RrWw]N",                                 //  67
        "12222~N",                                     //  68
        "1222~[J]@1222~N",                             //  69
        "1222~[J]",                                    //  70
        "1aa~[RW]N",                                   //  71
        "12aa~[W]N",                                   //  72
        "1222~[WwJ]@1222~N//1222~[WwwwJ]@1222~N",      //  73
        "1aa~[Rr]N",                                   //  74
        "1222~[WwJ]//1222~[WwwwJ]",                    //  75
        "12~[RrWw]N/12~[RrrrWwww]N/",                  //  76
        "12~[?]",                                      //  77
        "12222~[J]@12222~N",                           //  78
        "12222~[J]",                                   //  79
        "1222~[O]N",                                   //  80
        "12222~[WwJ]@12222~N//12222~[WwwwJ]@12222~N",  //  81
        "12222~[WwJ]//12222~[WwwwJ]",                  //  82
        "12~[Ww]N",                                    //  83
        "12aa~[RrWw]N",                                //  84
        "12aa~[RW]N",                                  //  85
        "12aa~[R]N",                                   //  86
        "1222~[R]N",                                   //  87
        "1222~[RW]N",                                  //  88
};

constexpr uint8_t PAGE00_TABLE[] = {
        1,   // 00: NOP     -                  1~N
        2,   // 01: LD      BC,0302H           1aa~N
        3,   // 02: LD      (BC),A             1~[W]N
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        21,  // FF: RST     38H                1~[WwJ]//1~[WwwwJ]
};

constexpr uint8_t PAGECB_TABLE[] = {
        4,   // 00: RLC     B                  12~N
        4,   // 01: RLC     C                  12~N
        4,   // 02: RLC     D                  12~N
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        4,   // FF: SET     7,A                12~N
};

constexpr uint8_t PAGEED_TABLE[] = {
        31,  // 00: IN0     B,(1)              122~N
        31,  // 01: OUT0    (2),B              122~N
        4,   // 02: LDW     BC,BC              12~N
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        4,   // FF: RESC    LCK                12~N
};

constexpr uint8_t PAGEEDCB_TABLE[] = {
        31,  // 00: RLCW    BC                 122~N
        31,  // 01: RLCW    DE                 122~N
        67,  // 02: RLCW    (HL)               122~[RrWw]N
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        0,   // FF
};

constexpr uint8_t PAGEDD_TABLE[] = {
        0,   // 00
        53,  // 01: LDW     (BC),IX            12~[Ww]N/12~[Wwww]N/
        4,   // 02: LDW     BC,DE              12~N
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        4,   // FF: RESC    LW                 12~N
};

constexpr uint8_t PAGEFD_TABLE[] = {
        0,   // 00
        53,  // 01: LDW     (BC),IY            12~[Ww]N/12~[Wwww]N/
        4,   // 02: LDW     BC,HL              12~N
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        81,  // C4: CALR    NZ,$-003936H
             // 12222~[WwJ]@12222~N//12222~[WwwwJ]@12222~N
        0,   // C5
        74,  // C6: ADDW    HL,(IY-57)         1aa~[Rr]N
        0,   // C7
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        81,  // CC: CALR    Z,$-00312EH
             // 12222~[WwJ]@12222~N//12222~[WwwwJ]@12222~N
        82,  // CD: CALR    $-00302DH          12222~[WwJ]//12222~[WwwwJ]
        74,  // CE: ADCW    HL,(IY-49)         1aa~[Rr]N
        0,   // CF
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        81,  // D4: CALR    NC,$-002926H
             // 12222~[WwJ]@12222~N//12222~[WwwwJ]@12222~N
        0,   // D5
        74,  // D6: SUBW    HL,(IY-41)         1aa~[Rr]N
        0,   // D7
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        81,  // DC: CALR    C,$-00211EH
             // 12222~[WwJ]@12222~N//12222~[WwwwJ]@12222~N
        0,   // DD
        74,  // DE: SBCW    HL,(IY-33)         1aa~[Rr]N
        0,   // DF
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        81,  // E4: CALR    PO,$-001916H
             // 12222~[WwJ]@12222~N//12222~[WwwwJ]@12222~N
        53,  // E5: PUSH    IY                 12~[Ww]N/12~[Wwww]N/
        74,  // E6: ANDW    HL,(IY-25)         1aa~[Rr]N
        0,   // E7
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        81,  // EC: CALR    PE,$-01110EH
             // 12222~[WwJ]@12222~N//12222~[WwwwJ]@12222~N
        0,   // ED
        74,  // EE: XORW    HL,(IY-17)         1aa~[Rr]N
        0,   // EF
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        81,  // F4: CALR    P,$-010906H
             // 12222~[WwJ]@12222~N//12222~[WwwwJ]@12222~N
        32,  // F5: PUSH    0F7F6H             12aa~[Ww]N/12aa~[Wwww]N/
        74,  // F6: ORW     HL,(IY-9)          1aa~[Rr]N
        83,  // F7: SETC    XM                 12~[Ww]N
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        81,  // FC: CALR    M,$-0000FEH
             // 12222~[WwJ]@12222~N//12222~[WwwwJ]@12222~N
        0,   // FD
        74,  // FE: CPW     HL,(IY-1)          1aa~[Rr]N
        0,   // FF
};

constexpr uint8_t PAGEDDCB_TABLE[] = {
        0,   // 00
        35,  // 01: LDW     BC,(SP-52)         12aa~[Rr]N/12aa~[Rrrr]N/
        84,  // 02: RLCW    (IX-52)            12aa~[RrWw]N
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        0,   // FF
};

constexpr uint8_t PAGEFDCB_TABLE[] = {
        0,   // 00
        75,  // 01: LDW     BC,(SP+5)          1222~[WwJ]//1222~[WwwwJ]
        84,  // 02: RLCW    (IY-52)            12aa~[RrWw]N
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        0,   // FF
};
// END GENERATED
// clang-format on

// Sequences: debugger/match_legend.md. An interrupt, NMI or trap, where
// the queue may have fetched ahead: an acknowledge but for the NMI's and a
// trap's, then the PC pushed and the vector fetched in either order.
constexpr const char INTERRUPT[] = "~![Ww?]@~[Ww?]";
constexpr const char INTERRUPT_XM[] = "~![Wwww?]@~[Wwww?]";

// The |n|th of |seq|'s variants: [from, to), empty where it has none.
void variant(const char *seq, int n, const char *&from, const char *&to) {
    from = seq;
    for (; n > 0; --n) {
        while (*from && *from != '/')
            ++from;
        if (*from == 0) {
            to = from;
            return;
        }
        ++from;
    }
    to = from;
    while (*to && *to != '/')
        ++to;
}

bool has(const char *from, const char *to, char c) {
    for (; from < to; ++from) {
        if (*from == c)
            return true;
    }
    return false;
}

// How an instruction moves the PC, by its page and opcode.
enum Flow : uint8_t { F_NONE, F_ABS, F_REL, F_RST, F_TRAP };

Flow flowOf(uint8_t page, uint8_t opc) {
    const auto group = opc & 0xC7;
    const auto jr = opc == 0x10 || opc == 0x18 || (opc & 0xE7) == 0x20;
    if (page == 0x00) {
        if (group == 0xC2 || group == 0xC4 || opc == 0xC3 || opc == 0xCD)
            return F_ABS;  // JP, CALL
        if (jr)
            return F_REL;  // JR, DJNZ
        if (group == 0xC7)
            return F_RST;
    } else if (page == 0xDD || page == 0xFD || page == 0xED) {
        if ((page != 0xED && jr) || opc == 0xCD || group == 0xC4)
            return F_REL;       // JR, DJNZ, CALR with a longer displacement
    } else if (page == 0xFC) {  // FD CB
        if ((opc & 0xC7) == 0x01 && opc != 0x21 && opc != 0x29)
            return F_TRAP;
    }
    return F_NONE;
}

}  // namespace

// A DDIR in front adds its IB/IW bytes after the "a" ones, widens a
// target, and picks the word size; one the instruction doesn't care for is
// two bytes of its own. J goes to a JP's or CALL's operand, a relative
// one's next + displacement, a RST's opcode & 38H, or a trap's 0000H.
bool InstZ380::decode(uint32_t pc, MatchWalker::Decoded &inst) const {
    auto read = [&](uint32_t addr) { return _mems->read_byte(addr); };
    auto b0 = read(pc);
    auto b1 = read(pc + 1);
    uint8_t extension = 0;  // DDIR IB/IW bytes
    uint8_t ddirWord = 0;   // DDIR: 0 none, 1 W, 2 LW
    uint8_t ddirLength = 0;
    // DDIR decoder directives: DD C0-C3 W, IB W, IW W, IB; FD C0-C3 LW,
    // IB LW, IW LW, IW.
    if ((b0 == 0xDD || b0 == 0xFD) && (b1 & 0xFC) == 0xC0) {
        const auto d = b1 & 3;
        extension = d == 3 ? (b0 == 0xDD ? 1 : 2) : d;
        ddirWord = d == 3 ? 0 : (b0 == 0xDD ? 1 : 2);
        ddirLength = 2;
        b0 = read(pc + 2);
        b1 = read(pc + 3);
    }
    const auto base = pc + ddirLength;
    const uint8_t *row;
    uint8_t page = b0;
    uint8_t opc = b1;
    uint8_t opcodeLength = 2;
    if (b0 == 0xCB) {
        row = &PAGECB_TABLE[b1];
    } else if (b0 == 0xED) {
        if (b1 == 0xCB) {
            opc = read(base + 2);
            page = 0xEC;  // ED CB
            row = &PAGEEDCB_TABLE[opc];
        } else {
            row = &PAGEED_TABLE[b1];
        }
    } else if (b0 == 0xDD || b0 == 0xFD) {
        if (b1 == 0xCB) {
            // the displacement, widened by IB or IW, before the opcode
            opc = read(base + 3 + extension);
            page = b0 == 0xDD ? 0xDC : 0xFC;  // DD CB, FD CB
            row = b0 == 0xDD ? &PAGEDDCB_TABLE[opc] : &PAGEFDCB_TABLE[opc];
        } else {
            row = b0 == 0xDD ? &PAGEDD_TABLE[b1] : &PAGEFD_TABLE[b1];
        }
    } else {
        page = 0x00;
        opc = b0;
        opcodeLength = 1;
        row = &PAGE00_TABLE[b0];
    }
    const auto seq = SEQUENCES[*row];
    if (*seq == 0)
        return false;
    const char *from, *to, *lwFrom, *lwTo, *xmFrom, *xmTo;
    variant(seq, 0, from, to);
    variant(seq, 1, lwFrom, lwTo);
    variant(seq, 2, xmFrom, xmTo);
    inst.pc = pc;
    inst.hasEa = false;
    inst.hasTarget = false;
    const auto widened = has(from, to, 'a');
    const auto block = has(from, to, '{') && !has(from, to, 'h');
    if (ddirLength && !widened) {
        if (block || lwFrom == lwTo) {
            // one the directive doesn't affect: two bytes of its own
            inst.seq = "12~N";
            inst.length = 2;
            return true;
        }
        extension = 0;
    }
    const auto lw = ddirWord == 2 || (ddirWord == 0 && _lw);
    if (_xm && xmFrom != xmTo) {
        from = xmFrom;
        to = xmTo;
    } else if (lw && lwFrom != lwTo) {
        from = lwFrom;
        to = lwTo;
    }
    // each alternative: the DDIR, then its own bytes and its IB/IW
    auto out = inst.text;
    const auto last = inst.text + sizeof(inst.text) - 1;
    auto put = [&](char c) {
        if (out == last)
            return false;
        *out++ = c;
        return true;
    };
    for (auto p = from; p < to; ++p) {
        if (p == from || p[-1] == '@') {
            if (ddirLength && !(put('1') && put('2')))
                return false;
            if (ddirLength && *p == '1') {
                if (!put('2'))
                    return false;
                continue;
            }
        }
        if (*p == 'a') {
            if (!put('2'))
                return false;
            if (p + 1 < to && p[1] != 'a') {
                for (auto k = 0u; k < extension; ++k) {
                    if (!put('2'))
                        return false;
                }
            }
            continue;
        }
        if (!put(*p))
            return false;
    }
    *out = 0;
    inst.seq = inst.text;
    inst.length = MatchWalker::instructionBytes(inst.text);
    const auto mask = _xm ? UINT32_MAX : UINT32_C(0xFFFF);
    const auto end = pc + inst.length;
    // the instruction's last |n| bytes, little endian
    auto operand = [&](uint_fast8_t n) {
        uint32_t v = 0;
        for (auto i = 0u; i < n; ++i)
            v |= static_cast<uint32_t>(read(end - n + i)) << (8 * i);
        return v;
    };
    switch (flowOf(page, opc)) {
    case F_ABS:
        inst.hasTarget = true;
        inst.target = operand(2 + extension) & mask;
        break;
    case F_REL: {
        const auto n = inst.length - ddirLength - opcodeLength;
        auto v = operand(n);
        const auto sign = UINT32_C(1) << (8 * n - 1);
        v = (v ^ sign) - sign;  // sign extended
        inst.hasTarget = true;
        inst.target = (end + v) & mask;
        break;
    }
    case F_RST:
        inst.hasTarget = true;
        inst.target = read(base) & 0x38;
        break;
    case F_TRAP:
        inst.hasTarget = true;
        inst.target = ORG_RESET;
        break;
    default:
        break;
    }
    return true;
}

MatchWalker::Kind InstZ380::cycleKind(const SignalsImpl *impl) const {
    const auto s = static_cast<const Signals *>(impl);
    if (s->halt())
        return MatchWalker::K_HALT;
    if (s->memReq())
        return s->read() ? MatchWalker::K_READ : MatchWalker::K_WRITE;
    if (s->intAck())
        return MatchWalker::K_ACK;
    if (!s->any())
        return MatchWalker::K_NONE;
    // RETI's I/O read too
    return s->write() ? MatchWalker::K_IO_WRITE : MatchWalker::K_IO_READ;
}

uint_fast8_t InstZ380::fetchBytes(const SignalsImpl *s) const {
    return static_cast<const Signals *>(s)->wordAccess() ? 2 : 1;
}

uint_fast8_t InstZ380::dataBytes(const SignalsImpl *s) const {
    return fetchBytes(s);
}

// A word's even byte rides the high lane, as a lone byte at an even
// address does.
uint8_t InstZ380::dataByte(const SignalsImpl *impl, uint_fast8_t k) const {
    const auto s = static_cast<const Signals *>(impl);
    const auto odd = s->wordAccess() ? k != 0 : (s->addr & 1) != 0;
    return odd ? s->data & 0xFF : s->data >> 8;
}

// Mode 0's acknowledge brings a RST; else the trap's, mode 1's or the
// NMI's.
bool InstZ380::entersInterrupt(
        const SignalsImpl *s, const SignalsImpl *ack) const {
    if (ack) {
        const auto v = ack->data & 0xFF;
        if ((v & 0xC7) == 0xC7)
            return s->addr == (v & 0x38u);
    }
    return s->addr == ORG_RESET || s->addr == ORG_RST38 || s->addr == ORG_NMI;
}

// One word pushed: where the CPU would have gone on, or for a trap the
// instruction it aborts.
bool InstZ380::pushesPc(
        const SignalsImpl *impl, uint32_t next, uint32_t last) const {
    const auto s = static_cast<const Signals *>(impl);
    if (_xm || next == UINT32_MAX)
        return true;
    const uint16_t pushed = (s->data << 8) | (s->data >> 8);
    return pushed == static_cast<uint16_t>(next) ||
           pushed == static_cast<uint16_t>(last);
}

const char *InstZ380::interruptSequence() const {
    return _xm ? INTERRUPT_XM : INTERRUPT;
}

void InstZ380::markCycle(
        SignalsImpl *impl, MatchWalker::Role role, uint_fast8_t) const {
    const auto s = static_cast<Signals *>(impl);
    switch (role) {
    case MatchWalker::R_FETCH:
        s->markFetch();
        break;
    case MatchWalker::R_BYTE:
        s->markByte();
        break;
    case MatchWalker::R_DATA:
        s->markOperand();
        break;
    default:
        if (!s->halt())
            s->clearMark();
        break;
    }
}

bool InstZ380::walk(Signals *begin, const Signals *end, const Memory &mems,
        uint32_t pc, bool xm, bool lw) {
    const InstZ380 arch(&mems, xm, lw);
    return MatchWalker::shared().walk(arch, begin, end, pc);
}

#ifndef ARDUINO
std::vector<const char *> InstZ380::sequences() {
    return std::vector<const char *>(
            std::begin(SEQUENCES), std::end(SEQUENCES));
}

std::vector<const char *> InstZ380::interrupts() {
    return {INTERRUPT, INTERRUPT_XM};
}
#endif

}  // namespace z380
}  // namespace debugger

// Local Variables:
// mode: c++
// c-basic-offset: 4
// tab-width: 4
// End:
// vim: set ft=cpp et ts=4 sw=4:
