#include "inst_hd6309.h"
#include <string.h>
#include "debugger.h"
#include "mems_mc6809.h"

namespace debugger {
namespace hd6309 {

namespace {
constexpr const char INTERRUPT[] =
        "1XxwWWWWWWWWWWWxVvxJ@1XxwWWxVvxJ/1XxwWWWWWWWWWWWWWxVvxJ";

constexpr const char *const SEQUENCES[/*seq*/] = {
        "",                                             //  0
        "Nx",                                           //  1
        "Nxx/Nx",                                       //  2
        "Nxxx/Nxx",                                     //  3
        "N",                                            //  4
        "3x",                                           //  5
        "34xxx/34xx",                                   //  6
        "NXxxx/NXx",                                    //  7
        "34xxxx/34xx",                                  //  8
        "NRrx",                                         //  9
        "NxxxRrx/NxxRrx",                               // 10
        "NxxxRrx/NxxRrX",                               // 11
        "NxRrx",                                        // 12
        "3xRrx",                                        // 13
        "34xxxRrx/34xxRrx",                             // 14
        "NXxxxRrx/NXxRrx",                              // 15
        "34xxxxRrx/34xxRrx",                            // 16
        "34xRrx/34Rrx",                                 // 17
        "34x",                                          // 18
        "34xRrx",                                       // 19
        "12xRxWN/12RxWN",                               // 20
        "123RxWN",                                      // 21
        "123RN",                                        // 22
        "12xRxxN/12RxN",                                // 23
        "12xi/12i",                                     // 24
        "1NN/1N",                                       // 25
        "1NXXN",                                        // 26
        "1NxxN",                                        // 27
        "123xxk/123xk",                                 // 28
        "123xxXxwWk/123xxwWk",                          // 29
        "12NN",                                         // 30
        "12xxxxxxN/12xxxN",                             // 31
        "12xxxxN/12xxN",                                // 32
        "12xj",                                         // 33
        "12xN",                                         // 34
        "12YxN",                                        // 35
        "12xxXQN/12xXQN",                               // 36
        "12xxPXi/12xPXi",                               // 37
        "1NRrxJ/1NRrJ",                                 // 38
        "1NxN/1N",                                      // 39
        "1NRrrrrrrrrrrrXJ@1NRrrXJ/1NRrrrrrrrrrrrrrXJ",  // 40
        "12NxwWWWWWWWWWWWN/12NxwWWWWWWWWWWWWWN",        // 41
        "1NZN",                                         // 42
        "1NxwWWWWWWWWWWWxVvxJ/1NxwWWWWWWWWWWWWWXVvxJ",  // 43
        "12YRxWN",                                      // 44
        "123YRxWN",                                     // 45
        "123YRN",                                       // 46
        "12YRxxN/12YRxN",                               // 47
        "12Yi",                                         // 48
        "123xAxBN/123RxWN",                             // 49
        "1234AxBN",                                     // 50
        "1234AN",                                       // 51
        "123xAxxN/123RxN",                              // 52
        "123xJ/123J",                                   // 53
        "12N",                                          // 54
        "123xN/123N",                                   // 55
        "12xXxwWj/12xxwWj",                             // 56
        "123N",                                         // 57
        "12xRN/12RN",                                   // 58
        "12xRrxN/12RrN",                                // 59
        "12xWN/12WN",                                   // 60
        "12xXxwWi/12xXwWi",                             // 61
        "12xRrN/12RrN",                                 // 62
        "12xWwN/12WwN",                                 // 63
        "12YRN",                                        // 64
        "12YRrxN/12YRrN",                               // 65
        "12YWN",                                        // 66
        "12YXxwWi/12YXwWi",                             // 67
        "12YRrN",                                       // 68
        "12YWwN",                                       // 69
        "123xAN/123AN",                                 // 70
        "123xAaxN/123AaN",                              // 71
        "123xWN/123WN",                                 // 72
        "123xAxwWJ/123xAwWJ",                           // 73
        "123xAaN/123AaN",                               // 74
        "123xWwN/123WwN",                               // 75
        "12345N",                                       // 76
        "123xBN/123BN",                                 // 77
        "123xBbN/123BbN",                               // 78
        "123xN",                                        // 79
        "123xN@123xxk/123xk",                           // 80
        "1NxwWN",                                       // 81
        "1NxRrN",                                       // 82
        "12xRrrrN/12RrrrN",                             // 83
        "12xWwwwN/12WwwwN",                             // 84
        "12YRrrrN",                                     // 85
        "12YWwwwN",                                     // 86
        "123xAaaaN/123AaaaN",                           // 87
        "123xBbbbN/123BbbbN",                           // 88
        "123xRxN/123RxN",                               // 89
        "123xRxWN/123RxWN",                             // 90
        "12xxxTN",                                      // 91
        "12XxN",                                        // 92
        "12NZN",                                        // 93
        "123NZN",                                       // 94
        "12xRZN",                                       // 95
        "12xRrZN",                                      // 96
        "12YRZN",                                       // 97
        "12YRrZN",                                      // 98
        "123xRZN",                                      // 99
        "123xRrZN",                                     // 100
};

constexpr uint8_t IX_TABLE[] = {
        1,   // 00: 0,X       -      1     0    N:x
        1,   // 01: 1,X       -      1     0    N:x
        1,   // 02: 2,X       -      1     0    N:x
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        0,   // FF: -         -      -     -    -
};

constexpr uint8_t P00_TABLE[] = {
        20,  // 00: NEG       d8     6/5   2    1:2:x:R:x:W:N/1:2:R:x:W:N
        21,  // 01: OIM       #,d8   6     3    1:2:3:R:x:W:N
        21,  // 02: AIM       #,d8   6     3    1:2:3:R:x:W:N
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        40,  // 3B: RTI       -     15/17  1
             // 1:N:R:r:r:r:r:r:r:r:r:r:r:r:X:J@1:N:R:r:r:X:J/1:N:R:r:r:r:r:r:r:r:r:r:r:r:r:r:X:J
        41,  // 3C: CWAI      -     20/22  2
             // 1:2:N:x:w:W:W:W:W:W:W:W:W:W:W:W:N/1:2:N:x:w:W:W:W:W:W:W:W:W:W:W:W:W:W:N
        42,  // 3D: MUL       -     11/10  1    1:N:Z:N
        0,   // 3E: -         -      -     -    -
        43,  // 3F: SWI       -     19/21  1
             // 1:N:x:w:W:W:W:W:W:W:W:W:W:W:W:x:V:v:x:J/1:N:x:w:W:W:W:W:W:W:W:W:W:W:W:W:W:X:V:v:x:J
        25,  // 40: NEGA      -      2/1   1    1:N:N/1:N
        0,   // 41: -         -      -     -    -
        0,   // 42: -         -      -     -    -
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        78,  // FF: STU       a16    6/5   3    1:2:3:x:B:b:N/1:2:3:B:b:N
};

constexpr uint8_t P10_TABLE[] = {
        0,   // 00: -         -      -     -    -
        0,   // 01: -         -      -     -    -
        0,   // 02: -         -      -     -    -
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        43,  // 3F: SWI2      -     19/21  1
             // 1:N:x:w:W:W:W:W:W:W:W:W:W:W:W:x:V:v:x:J/1:N:x:w:W:W:W:W:W:W:W:W:W:W:W:W:W:X:V:v:x:J
        25,  // 40: NEGD      -      2/1   1    1:N:N/1:N
        0,   // 41: -         -      -     -    -
        0,   // 42: -         -      -     -    -
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        78,  // FF: STS       a16    6/5   3    1:2:3:x:B:b:N/1:2:3:B:b:N
};

constexpr uint8_t P11_TABLE[] = {
        0,   // 00: -         -      -     -    -
        0,   // 01: -         -      -     -    -
        0,   // 02: -         -      -     -    -
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        43,  // 3F: SWI3      -     19/21  1
             // 1:N:x:w:W:W:W:W:W:W:W:W:W:W:W:x:V:v:x:J/1:N:x:w:W:W:W:W:W:W:W:W:W:W:W:W:W:X:V:v:x:J
        0,   // 40: -         -      -     -    -
        0,   // 41: -         -      -     -    -
        0,   // 42: -         -      -     -    -
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        0,    // FF: -         -      -     -    -
};
}  // namespace

struct InstHd6309::StrBuffer {
    StrBuffer() : _out(0) {}
    operator const char *() const { return _buffer; }
    char *out() { return &_buffer[_out]; }
    void letter(char c) {
        if (_out < sizeof(_buffer) - 1)
            _buffer[_out++] = c;
        _buffer[_out] = 0;
    }

private:
    char _buffer[30];
    uint8_t _out;
};

bool InstHd6309::matchInterrupt(
        const mc6800::Signals *begin, const mc6800::Signals *end) {
    if (!begin->read())
        return false;
    const char *intr = INTERRUPT;
    while (*intr) {
        StrBuffer sequence;
        intr = copySequence(intr, sequence);
        if (matchSequence(begin, end, sequence, nullptr))
            return true;
        if (*intr == '/') {
            if (_type == SoftwareType::SW_MC6809)
                break;
            ++intr;
        } else if (*intr == '@') {
            ++intr;
        }
    }
    return false;
}

bool InstHd6309::match(const mc6800::Signals *begin, const mc6800::Signals *end,
        const mc6800::Signals *prefetch) {
    // |prefetch| must be nullptr
    if (!begin->read())
        return false;
    auto table = P00_TABLE;
    auto opc = _mems->raw_read(begin->addr);
    uint8_t prefix = 0;
    if (opc == 0x10 || opc == 0x11) {
        const auto fetch = begin->next();
        if (fetch == end || !fetch->read() || fetch->addr != begin->addr + 1U)
            return false;
        LOG_MATCH(cli.print("@@  match: opc="));
        LOG_MATCH(cli.printHex(opc));
        prefix = 1;
        table = (opc == 0x10) ? P10_TABLE : P11_TABLE;
        opc = _mems->raw_read(fetch->addr);
        LOG_MATCH(cli.print(':'));
        LOG_MATCH(cli.printHex(opc, 2));
    } else {
        LOG_MATCH(cli.print("@@  match: opc="));
        LOG_MATCH(cli.printHex(opc, 2));
    }
    _matchingNative6309 = false;
    const char *seq = SEQUENCES[table[opc]];
    LOG_MATCH(cli.print(" seq="));
    LOG_MATCH(cli.printDec(table[opc]));
    LOG_MATCH(cli.print(':'));
    LOG_MATCH(cli.println(seq));
    while (*seq) {
        StrBuffer sequence;
        const auto fetch = begin->next(prefix);
        seq = assembleSequence(fetch->addr, seq, sequence);
        LOG_MATCH(cli.print("@@      native="));
        LOG_MATCH(cli.printlnDec(_matchingNative6309));
        if (matchSequence(fetch, end, sequence, nullptr)) {
            _matched += prefix;
            return true;
        }
        if (*seq == '/') {
            if (_type == SoftwareType::SW_MC6809)
                break;
            _matchingNative6309 = true;
            ++seq;
        } else if (*seq == '@') {
            ++seq;
        }
    }
    return false;
}

const char *InstHd6309::assembleSequence(
        uint16_t fetch, const char *seq, StrBuffer &sequence) const {
    while (true) {
        const auto c = *seq;
        if (c == 0 || c == '@' || c == '/')
            return seq;
        if (c == 'Y') {
            const auto post = _mems->raw_read(fetch + 1);
            auto ix = SEQUENCES[IX_TABLE[post]];
            if (_matchingNative6309) {
                const auto native = strchr(ix, '/');
                if (native)
                    ix = native + 1;
            }
            while (*ix && *ix != '/')
                sequence.letter(*ix++);
        } else if (c == 'P') {
            const auto post = _mems->raw_read(fetch + 1);
            const auto bottom = sequence.out();
            appendStackSequence(post, 0x01, 'r', sequence);  // CC
            appendStackSequence(post, 0x02, 'r', sequence);  // A
            appendStackSequence(post, 0x04, 'r', sequence);  // B
            appendStackSequence(post, 0x08, 'r', sequence);  // DP
            appendStackSequence(post, 0x10, 'r', sequence);  // X
            appendStackSequence(post, 0x20, 'r', sequence);  // Y
            appendStackSequence(post, 0x40, 'r', sequence);  // U
            appendStackSequence(post, 0x80, 'r', sequence);  // PC
            if (sequence.out() != bottom)
                *bottom = 'R';
        } else if (c == 'Q') {
            const auto post = _mems->raw_read(fetch + 1);
            const auto top = sequence.out();
            appendStackSequence(post, 0x80, 'W', sequence);  // PC
            appendStackSequence(post, 0x40, 'W', sequence);  // U
            appendStackSequence(post, 0x20, 'W', sequence);  // Y
            appendStackSequence(post, 0x10, 'W', sequence);  // X
            appendStackSequence(post, 0x08, 'W', sequence);  // DP
            appendStackSequence(post, 0x04, 'W', sequence);  // B
            appendStackSequence(post, 0x02, 'W', sequence);  // A
            appendStackSequence(post, 0x01, 'W', sequence);  // CC
            if (sequence.out() != top)
                *top = 'w';
        } else {
            sequence.letter(c);
        }
        ++seq;
    }
}

void InstHd6309::appendStackSequence(
        uint8_t post, uint8_t mask, char c, StrBuffer &sequence) {
    if (post & mask) {
        sequence.letter(c);
        if (mask >= 0x08)
            sequence.letter(c);
    }
}

const char *InstHd6309::copySequence(const char *seq, StrBuffer &sequence) {
    while (true) {
        const auto c = *seq;
        if (c == 0 || c == '@' || c == '/')
            return seq;
        sequence.letter(c);
        ++seq;
    }
}

}  // namespace hd6309
}  // namespace debugger

// Local Variables:
// mode: c++
// c-basic-offset: 4
// tab-width: 4
// End:
// vim: set ft=cpp et ts=4 sw=4:
