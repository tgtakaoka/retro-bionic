#include "inst_hd6309.h"
#include <string.h>

namespace debugger {
namespace hd6309 {

namespace {
// Sequences: debugger/match_legend.md. The MC6809's interrupts, and the
// HD6309's, its native mode's too.
constexpr const char INTERRUPT_6809[] = "XXxwWWWWWWWWWWWxVrxP@XXxwWWxVrxP";
constexpr const char INTERRUPT_6309[] =
        "XXxwWWWWWWWWWWWxVrxP@XXxwWWxVrxP"
        // native: a read more before the pushes, and E and F pushed
        "@XXXxwWWxVrxP@XXXxwWWWWWWWWWWWWWxVrxP";

// Generated by: gawk -f inst_hd6309.awk hd6309-IX.txt hd6309-P00.txt
//     hd6309-P10.txt hd6309-P11.txt | clang-format
constexpr const char *const SEQUENCES[/*seq*/] = {
        "",                                             //  0
        "nx",                                           //  1
        "nxx/nx",                                       //  2
        "nxxx/nxx",                                     //  3
        "n",                                            //  4
        "2x",                                           //  5
        "22Xxx/22xx",                                   //  6
        "nXXxx/nXx",                                    //  7
        "22Xxxx/22xx",                                  //  8
        "nRrx",                                         //  9
        "nxxxRrx/nxxRrx",                               // 10
        "nxxxRrx/nxxRrX",                               // 11
        "nxRrx",                                        // 12
        "2xRrx",                                        // 13
        "22XxxRrx/22xxRrx",                             // 14
        "nXXxxRrx/nXxRrx",                              // 15
        "22XxxxRrx/22xxRrx",                            // 16
        "22XRrx/22Rrx",                                 // 17
        "22x",                                          // 18
        "22xRrx",                                       // 19
        "12xRxWN/12RxWN",                               // 20
        "122RxWN",                                      // 21
        "122RN",                                        // 22
        "12xRxxN/12RxN",                                // 23
        "12x?/12?",                                     // 24
        "1nN/1N",                                       // 25
        "1nXXN",                                        // 26
        "1nxxN",                                        // 27
        "122xxJ@122xxN/122xJ@122xN",                    // 28
        "122xxXxwWJ@122xxXxwWN/122xxwWJ@122xxwWN",      // 29
        "12nN/12xN",                                    // 30
        "12xxxxxxN/12xxxN",                             // 31
        "12xxxxN/12xxN",                                // 32
        "12xJ@12xN",                                    // 33
        "12xN",                                         // 34
        "12#xN",                                        // 35
        "12xxX>N/12xX>N",                               // 36
        "12xx<X?/12x<X?",                               // 37
        "1nRrxP/1nRrP",                                 // 38
        "1nxN/1N",                                      // 39
        "1nRrrrrrrrrrrrXP@1nRrrXP/1nRrrrrrrrrrrrrrXP",  // 40
        "12nxwWWWWWWWWWWWN/12nxwWWWWWWWWWWWWWN",        // 41
        "1n{x}N",                                       // 42
        "1nxwWWWWWWWWWWWxVrxP/1nxwWWWWWWWWWWWWWXVrxP",  // 43
        "12#RxWN",                                      // 44
        "122#RxWN",                                     // 45
        "122#RN",                                       // 46
        "12#RxxN/12#RxN",                               // 47
        "12#?",                                         // 48
        "122xAxBN/122RxWN",                             // 49
        "1222AxBN",                                     // 50
        "1222AN",                                       // 51
        "122xAxxN/122RxN",                              // 52
        "122xJ/122J",                                   // 53
        "12N",                                          // 54
        "122xN/122N",                                   // 55
        "12xXxwWJ@12xXxwWN/12xxwWJ@12xxwWN",            // 56
        "122N",                                         // 57
        "12xRN/12RN",                                   // 58
        "12xRrxN/12RrN",                                // 59
        "12xWN/12WN",                                   // 60
        "12xXxwW?/12xXwW?",                             // 61
        "12xRrN/12RrN",                                 // 62
        "12xWwN/12WwN",                                 // 63
        "12#RN",                                        // 64
        "12#RrxN/12#RrN",                               // 65
        "12#WN",                                        // 66
        "12#XxwW?/12#XwW?",                             // 67
        "12#RrN",                                       // 68
        "12#WwN",                                       // 69
        "122xAN/122AN",                                 // 70
        "122xArxN/122ArN",                              // 71
        "122xWN/122WN",                                 // 72
        "122xAxwWJ/122xAwWJ",                           // 73
        "122xArN/122ArN",                               // 74
        "122xWwN/122WwN",                               // 75
        "12222N",                                       // 76
        "122xBN/122BN",                                 // 77
        "122xBwN/122BwN",                               // 78
        "122xN",                                        // 79
        "122xN@122xxJ@122xxN/122xJ@122xN",              // 80
        "1nxwWN",                                       // 81
        "1nxRrN",                                       // 82
        "12xRrrrN/12RrrrN",                             // 83
        "12xWwwwN/12WwwwN",                             // 84
        "12#RrrrN",                                     // 85
        "12#WwwwN",                                     // 86
        "122xArrrN/122ArrrN",                           // 87
        "122xBwwwN/122BwwwN",                           // 88
        "122xRxN/122RxN",                               // 89
        "122xRxWN/122RxWN",                             // 90
        "12xxx{R+1xW+1}N",                              // 91
        "12xxx{R-1xW-1}N",                              // 92
        "12xxx{R+1xW0}N",                               // 93
        "12xxx{R0xW+1}N",                               // 94
        "12XxN",                                        // 95
        "12{x}N",                                       // 96
        "122{x}N",                                      // 97
        "12xR{x}N/12R{x}N",                             // 98
        "12xRr{x}N/12Rr{x}N",                           // 99
        "12#R{x}N",                                     // 100
        "12#Rr{x}N",                                    // 101
        "122xR{x}N/122R{x}N",                           // 102
        "122xRr{x}N/122Rr{x}N",                         // 103
};

constexpr uint8_t IX_TABLE[] = {
        1,   // 00: 0,X       -      1     0    nx
        1,   // 01: 1,X       -      1     0    nx
        1,   // 02: 2,X       -      1     0    nx
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        0,   // FF: -         -      -     -    -
};

constexpr uint8_t P00_TABLE[] = {
        20,  // 00: NEG       d8     6/5   2    12xRxWN/12RxWN
        21,  // 01: OIM       #,d8   6     3    122RxWN
        21,  // 02: AIM       #,d8   6     3    122RxWN
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        29,  // 17: LBSR      r16    9/7   3
             // 122xxXxwWJ@122xxXxwWN/122xxwWJ@122xxwWN
        0,   // 18: -         -      -     -    -
        25,  // 19: DAA       -      2/1   1    1nN/1N
        30,  // 1A: ORCC      #n8    3     2    12nN/12xN
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        40,  // 3B: RTI       -     15/17  1
             // 1nRrrrrrrrrrrrXP@1nRrrXP/1nRrrrrrrrrrrrrrXP
        41,  // 3C: CWAI      -     20/22  2
             // 12nxwWWWWWWWWWWWN/12nxwWWWWWWWWWWWWWN
        42,  // 3D: MUL       -     11/10  1    1n{x}N
        0,   // 3E: -         -      -     -    -
        43,  // 3F: SWI       -     19/21  1
             // 1nxwWWWWWWWWWWWxVrxP/1nxwWWWWWWWWWWWWWXVrxP
        25,  // 40: NEGA      -      2/1   1    1nN/1N
        0,   // 41: -         -      -     -    -
        0,   // 42: -         -      -     -    -
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        78,  // FF: STU       a16    6/5   3    122xBwN/122BwN
};

constexpr uint8_t P10_TABLE[] = {
        0,   // 00: -         -      -     -    -
        0,   // 01: -         -      -     -    -
        0,   // 02: -         -      -     -    -
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        43,  // 3F: SWI2      -     19/21  1
             // 1nxwWWWWWWWWWWWxVrxP/1nxwWWWWWWWWWWWWWXVrxP
        25,  // 40: NEGD      -      2/1   1    1nN/1N
        0,   // 41: -         -      -     -    -
        0,   // 42: -         -      -     -    -
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        78,  // FF: STS       a16    6/5   3    122xBwN/122BwN
};

constexpr uint8_t P11_TABLE[] = {
        0,    // 00: -         -      -     -    -
        0,    // 01: -         -      -     -    -
        0,    // 02: -         -      -     -    -
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        43,   // 3F: SWI3      -     19/21  1
              // 1nxwWWWWWWWWWWWxVrxP/1nxwWWWWWWWWWWWWWXVrxP
        0,    // 40: -         -      -     -    -
        0,    // 41: -         -      -     -    -
        0,    // 42: -         -      -     -    -
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        0,    // FF: -         -      -     -    -
};

// Puts a sequence together, as long as it fits.
struct Text {
    char *out;
    const char *const last;
    bool put(char c) {
        if (out == last)
            return false;
        *out++ = c;
        return true;
    }
    bool stack(uint8_t post, uint8_t mask, char c) {
        if ((post & mask) == 0)
            return true;
        return put(c) && (mask < 0x10 || put(c));
    }
};

// The alternatives of [seq, end): a prefix's 1 before each's, the
// postbyte |post|'s fragment for #, in native mode if |native|, and pulls
// and pushes of its registers for < and >.
bool assemble(const char *seq, const char *end, bool prefix, uint8_t post,
        bool native, Text &text) {
    auto first = true;
    for (auto p = seq; p < end; ++p) {
        const auto c = *p;
        if (c == '@') {
            first = true;
            if (!text.put(c))
                return false;
            continue;
        }
        if (first && prefix && !text.put('1'))
            return false;
        if (c == '1' && first && prefix) {
            if (!text.put('2'))
                return false;
        } else if (c == '#') {
            auto ix = SEQUENCES[IX_TABLE[post]];
            const auto variant = strchr(ix, '/');
            if (native && variant)
                ix = variant + 1;
            for (; *ix && *ix != '/'; ++ix) {
                if (!text.put(*ix))
                    return false;
            }
        } else if (c == '<') {  // the first pulled starts the value
            const auto bottom = text.out;
            constexpr uint8_t pulls[] = {0x01, 0x02, 0x04, 0x08, 0x10, 0x20,
                    0x40, 0x80};  // CC A B DP X Y U PC
            for (const auto mask : pulls) {
                if (!text.stack(post, mask, 'r'))
                    return false;
            }
            if (text.out != bottom)
                *bottom = 'R';
        } else if (c == '>') {  // the first pushed is the top
            const auto top = text.out;
            constexpr uint8_t pushes[] = {0x80, 0x40, 0x20, 0x10, 0x08, 0x04,
                    0x02, 0x01};  // PC U Y X DP B A CC
            for (const auto mask : pushes) {
                if (!text.stack(post, mask, 'W'))
                    return false;
            }
            if (text.out != top)
                *top = 'w';
        } else if (!text.put(c)) {
            return false;
        }
        first = false;
    }
    return true;
}

}  // namespace

// The MC6809's alternatives, and on an HD6309 the native mode's after
// them: its variant after a /, or the same with the postbyte's. J goes to
// the operand, a branch's to the next + disp.
bool InstHd6309::decode(uint32_t pc, MatchWalker::Decoded &inst) const {
    pc &= 0xFFFF;
    auto read = [&](uint32_t addr) { return _mems->read_byte(addr & 0xFFFF); };
    auto table = P00_TABLE;
    auto opc = read(pc);
    const auto prefix = opc == 0x10 || opc == 0x11;
    if (prefix) {
        table = opc == 0x10 ? P10_TABLE : P11_TABLE;
        opc = read(pc + 1);
    }
    const auto seq = SEQUENCES[table[opc]];
    if (*seq == 0)
        return false;
    const auto end = seq + strlen(seq);
    const auto variant = strchr(seq, '/');
    const auto post = read(pc + prefix + 1);
    Text text{inst.text, inst.text + sizeof(inst.text) - 1};
    if (!assemble(seq, variant ? variant : end, prefix, post, false, text))
        return false;
    if (_type != mc6809::SW_MC6809 && (variant || strchr(seq, '#'))) {
        const auto mc6809 = text.out;
        const auto from = variant ? variant + 1 : seq;
        if (!text.put('@') || !assemble(from, end, prefix, post, true, text))
            return false;
        const auto len = mc6809 - inst.text;
        if (text.out - mc6809 - 1 == len &&
                memcmp(inst.text, mc6809 + 1, len) == 0)
            text.out = mc6809;  // the same in either mode
    }
    *text.out = 0;
    inst.pc = pc;
    inst.seq = inst.text;
    inst.length = MatchWalker::instructionBytes(inst.text);
    const auto next = pc + inst.length;
    const uint16_t operand = read(next - 2) << 8 | read(next - 1);
    inst.hasEa = inst.hasTarget = true;
    inst.ea = operand;
    const auto page0 = table == P00_TABLE;
    if ((page0 && ((opc & 0xF0) == 0x20 || opc == 0x8D))) {  // Bcc, BSR
        inst.target = (next + static_cast<int8_t>(operand)) & 0xFFFF;
    } else if ((page0 && (opc == 0x16 || opc == 0x17)) ||
               (table == P10_TABLE && (opc & 0xF0) == 0x20)) {  // LBcc
        inst.target = (next + static_cast<int16_t>(operand)) & 0xFFFF;
    } else {
        inst.target = operand;
    }
    return true;
}

const char *InstHd6309::intrSequence() const {
    return _type == mc6809::SW_MC6809 ? INTERRUPT_6809 : INTERRUPT_6309;
}

}  // namespace hd6309
}  // namespace debugger

// Local Variables:
// mode: c++
// c-basic-offset: 4
// tab-width: 4
// End:
// vim: set ft=cpp et ts=4 sw=4:
