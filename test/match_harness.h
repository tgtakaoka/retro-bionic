// Replays bench recordings through a cycle matcher on the host and checks
// where it starts and the mark it leaves on every cycle against a golden
// file. Besides each recorded run, it replays the run with its first
// cycle cut, and the run followed by the next one, so the start scan
// and the failures are covered too.
//
// MATCH_GOLDEN=<dir> writes the goldens there from the matcher instead.
//
// A test's fixtures sit next to it, by set: <set>.cycles.zst the rings,
// <set>.marks.zst the golden. Both are zstd text, a "# Generated by:"
// line then a record per line, its fields tab-separated:
//   cycles  key, stop (hex, - if none), cycles, memory, starts; a cycle
//           is kind,addr,data,mark[,cntl] (kind _ when blank; hex but
//           the mark), memory and starts only a bench ring's
//   marks   name, start (-1: none), a raw mark per cycle (0 as a dot)
// A set whose rings aren't there yet is skipped.
//
// A bench ring, recorded where a running sample stopped, comes with the
// program its code was in and its listing's instruction starts: it is
// replayed as is, and every fetch the matcher marks but its first two,
// where the ring may have begun inside an instruction, must be at one.

#ifndef __TEST_MATCH_HARNESS_H__
#define __TEST_MATCH_HARNESS_H__

#include <unity.h>

#include <ctype.h>
#include <stdint.h>
#include <stdio.h>
#include <stdlib.h>
#include <string.h>
#include <string>
#include <type_traits>
#include <vector>

#include <zstd.h>

#include "cycles.h"
#include "match_memory.h"

namespace debugger {
struct MatchWalker;  // a test includes it after its #define protected public
}

namespace match_harness {

struct Cycle {
    char kind;  // R, W, or blank
    uint32_t addr;
    uint16_t data;
    int mark;      // what the profile image printed, if anything
    int cntl = 0;  // the control lines, where the recording has them
};

struct Ring {
    std::string key;
    std::vector<Cycle> cycles;
    uint32_t stop = 0;   // where the CPU stopped, for a matcher that needs it
    std::string memory;  // a bench ring's: "addr:hexbytes ..."
    std::string starts;  // and its listing's: "addr addr ..."
};

struct Result {
    std::string name;
    int start;
    std::string marks;
};

// The directory of |file|, a test's __FILE__.
inline std::string dirOf(const char *file) {
    const std::string f = file;
    return f.substr(0, f.rfind('/') + 1);
}

// What a fixture that can't be read is: it may be read before the tests
// run, so not an assertion.
[[noreturn]] inline void broken(const std::string &path, const char *why) {
    fprintf(stderr, "%s: %s\n", path.c_str(), why);
    exit(1);
}

// The text of the zstd file |path|; false if there is none.
inline bool readZst(const std::string &path, std::string &text) {
    FILE *f = fopen(path.c_str(), "rb");
    if (f == nullptr)
        return false;
    std::string packed;
    char buf[1 << 16];
    for (size_t n; (n = fread(buf, 1, sizeof(buf), f)) > 0;)
        packed.append(buf, n);
    fclose(f);
    text.clear();
    const auto dctx = ZSTD_createDCtx();
    ZSTD_inBuffer in{packed.data(), packed.size(), 0};
    while (in.pos < in.size) {
        ZSTD_outBuffer out{buf, sizeof(buf), 0};
        const auto r = ZSTD_decompressStream(dctx, &out, &in);
        if (ZSTD_isError(r))
            broken(path, ZSTD_getErrorName(r));
        text.append(buf, out.pos);
    }
    ZSTD_freeDCtx(dctx);
    return true;
}

inline void writeZst(const std::string &path, const std::string &text) {
    std::string packed(ZSTD_compressBound(text.size()), 0);
    const auto n = ZSTD_compress(
            packed.data(), packed.size(), text.data(), text.size(), 19);
    TEST_ASSERT_FALSE_MESSAGE(ZSTD_isError(n), path.c_str());
    FILE *f = fopen(path.c_str(), "wb");
    TEST_ASSERT_NOT_NULL_MESSAGE(f, path.c_str());
    fwrite(packed.data(), 1, n, f);
    fclose(f);
}

// The records of the zstd text file |path|, each its tab-separated
// fields; none if there is no such file.
inline std::vector<std::vector<std::string>> records(const std::string &path) {
    std::vector<std::vector<std::string>> list;
    std::string text;
    if (!readZst(path, text))
        return list;
    size_t at = 0;
    while (at < text.size()) {
        auto eol = text.find('\n', at);
        if (eol == std::string::npos)
            eol = text.size();
        const auto line = text.substr(at, eol - at);
        at = eol + 1;
        if (line.empty() || line[0] == '#')
            continue;
        std::vector<std::string> fields;
        size_t from = 0;
        for (size_t tab; (tab = line.find('\t', from)) != std::string::npos;
                from = tab + 1)
            fields.push_back(line.substr(from, tab - from));
        fields.push_back(line.substr(from));
        list.push_back(fields);
    }
    return list;
}

// The rings of |set| in |dir|, <set>.cycles.zst; none if it isn't there.
inline std::vector<Ring> loadRings(const std::string &dir, const char *set) {
    std::vector<Ring> rings;
    for (const auto &f : records(dir + set + ".cycles.zst")) {
        if (f.size() < 3)
            broken(dir + set + ".cycles.zst", "a ring without its cycles");
        Ring r;
        r.key = f[0];
        r.stop = f[1] == "-" ? 0 : strtoul(f[1].c_str(), nullptr, 16);
        for (auto p = f[2].c_str(); *p;) {
            Cycle c{};
            char *q;
            c.kind = *p == '_' ? ' ' : *p;
            c.addr = strtoul(p + 2, &q, 16);
            c.data = strtoul(q + 1, &q, 16);
            c.mark = strtol(q + 1, &q, 10);
            if (*q == ',')
                c.cntl = strtoul(q + 1, &q, 16);
            r.cycles.push_back(c);
            p = *q ? q + 1 : q;
        }
        if (f.size() > 3)
            r.memory = f[3];
        if (f.size() > 4)
            r.starts = f[4];
        rings.push_back(r);
    }
    if (rings.empty())
        printf("%s: no %s.cycles.zst\n", dir.c_str(), set);
    return rings;
}

// |seq| is a sequence of match_legend.md's tokens, |own| those its
// decoder expands; and each of a table's.
template <typename WALKER = debugger::MatchWalker>
void checkSequence(const char *seq, const char *own = "") {
    const auto why = WALKER::illFormed(seq, own);
    if (why)
        printf("\"%s\": %s\n", seq, why);
    TEST_ASSERT_NULL_MESSAGE(why, seq);
}

// |seq| is an interrupt's, if any: its alternatives may be of any length.
template <typename WALKER = debugger::MatchWalker>
void checkInterrupt(const char *seq) {
    if (seq == nullptr)
        return;
    const auto why = WALKER::illFormed(seq, "", false);
    if (why)
        printf("\"%s\": %s\n", seq, why);
    TEST_ASSERT_NULL_MESSAGE(why, seq);
}

template <typename WALKER = debugger::MatchWalker, typename TABLE>
void checkSequences(const TABLE &seqs, const char *own = "") {
    for (const char *seq : seqs)
        checkSequence<WALKER>(seq, own);
}

// The bench ring being replayed's memory, if any.
inline const char *memory;

// "addr:hexbytes ...", each byte to |put(addr, byte)|.
template <typename PUT>
void loadMemory(const char *text, PUT put) {
    for (auto p = text; p && *p;) {
        char *q;
        auto addr = strtoul(p, &q, 16);
        for (p = q + 1; isxdigit(p[0]) && isxdigit(p[1]); p += 2) {
            const char hex[3] = {p[0], p[1], 0};
            put(addr++, strtoul(hex, nullptr, 16));
        }
        while (*p == ' ')
            ++p;
    }
}

// Memory as a ring's reads left it, |fill| elsewhere: a later read of an
// address wins. A bench ring's program wins over its reads, as the
// board's memory does where a breakpoint's opcode stands in.
struct RingMemory final : debugger::MatchMemory {
    RingMemory(const std::vector<Cycle> &cycles, uint8_t fill)
        : _mem(1 << 16, fill) {
        for (const auto &c : cycles) {
            if (c.kind == 'R')
                _mem[c.addr & 0xFFFF] = c.data;
        }
        loadMemory(memory,
                [&](uint32_t addr, uint8_t b) { _mem[addr & 0xFFFF] = b; });
    }
    uint16_t read_byte(uint32_t addr) const override {
        return _mem[addr & 0xFFFF];
    }

private:
    std::vector<uint8_t> _mem;
};

// A replayed ring: its name, its cycles and where the CPU stopped.
struct Scenario {
    std::string name;
    std::vector<Cycle> cycles;
    uint32_t stop;
    const char *memory = nullptr;
    const char *starts = nullptr;
};

// The scenarios: each ring, the ring without its first cycle, and the
// ring followed by the next, which stops where the next does.
inline std::vector<Scenario> scenarios(const std::vector<Ring> &rings) {
    std::vector<Scenario> list;
    for (size_t i = 0; i < rings.size(); ++i) {
        const auto &r = rings[i];
        if (!r.memory.empty()) {  // a bench ring: as it was recorded
            list.push_back(Scenario{r.key, r.cycles, r.stop, r.memory.c_str(),
                    r.starts.c_str()});
            continue;
        }
        list.push_back(Scenario{r.key, r.cycles, r.stop});
        if (r.cycles.size() > 1)
            list.push_back(Scenario{r.key + "-1",
                    std::vector<Cycle>(r.cycles.begin() + 1, r.cycles.end()),
                    r.stop});
        if (i + 1 < rings.size()) {
            auto both = r.cycles;
            const auto &n = rings[i + 1];
            both.insert(both.end(), n.cycles.begin(), n.cycles.end());
            list.push_back(Scenario{r.key + "+" + n.key, both, n.stop});
        }
    }
    return list;
}

// |replay(cycles, marks)|, or with the stop when it takes one.
template <typename REPLAY>
int replayOf(REPLAY &replay, const std::vector<Cycle> &cycles,
        std::vector<int> &marks, uint32_t stop) {
    if constexpr (std::is_invocable_v<REPLAY &, const std::vector<Cycle> &,
                          std::vector<int> &, uint32_t>) {
        return replay(cycles, marks, stop);
    } else {
        return replay(cycles, marks);
    }
}

// The scenario being replayed, for a replay to trace one: WALK_TRACE=<name>.
inline std::string current;

inline bool tracing() {
    const auto name = getenv("WALK_TRACE");
    return name && current == name;
}

// Whether a raw mark is a fetch's: the test sets it where not every
// nonzero one is.
inline bool (*isFetch)(int mark) = [](int mark) { return mark != 0; };

// The fetches |marks| has but at |starts|, the first two excepted.
inline std::string unlisted(const Scenario &sc, const std::vector<int> &marks) {
    std::string off;
    if (sc.starts == nullptr)
        return off;
    const auto starts = std::string(" ") + sc.starts + " ";
    auto seen = 0;
    for (size_t i = 0; i < marks.size(); ++i) {
        if (!isFetch(marks[i]) || seen++ < 2)
            continue;
        char addr[16];
        snprintf(addr, sizeof(addr), " %X ", (unsigned)sc.cycles[i].addr);
        if (starts.find(addr) == std::string::npos)
            off += addr + 1;
    }
    return off;
}

// The marks of a scenario as the golden has them: a raw mark per cycle,
// 0 as a dot.
inline std::string format(const std::vector<int> &marks) {
    std::string s;
    for (const auto m : marks) {
        if (!s.empty())
            s += ' ';
        s += m ? std::to_string(m) : ".";
    }
    return s;
}

// Runs |replay(cycles, marks)|, or |replay(cycles, marks, stop)|, on
// every scenario of |set|'s |rings|, which returns the start's index or -1
// and appends one raw mark per cycle to |marks|, and checks them against
// <set>.marks.zst in |dir|.
template <typename REPLAY>
void check(const std::string &dir, const char *set,
        const std::vector<Ring> &rings, REPLAY replay) {
    if (rings.empty())
        return;
    const auto file = std::string(set) + ".marks.zst";
    std::vector<Result> results;
    unsigned off = 0;
    for (const auto &sc : scenarios(rings)) {
        TEST_ASSERT_LESS_THAN(debugger::Cycles::MAX_CYCLES, sc.cycles.size());
        std::vector<int> marks;
        current = sc.name;
        memory = sc.memory;
        const auto start = replayOf(replay, sc.cycles, marks, sc.stop);
        memory = nullptr;
        results.push_back(Result{sc.name, start, format(marks)});
        const auto missed = unlisted(sc, marks);
        if (!missed.empty()) {
            printf("%s: fetches off the listing: %s\n", sc.name.c_str(),
                    missed.c_str());
            ++off;
        }
    }
    TEST_ASSERT_EQUAL_MESSAGE(0, off, "bench rings fetching off the listing");
    if (const auto out = getenv("MATCH_GOLDEN")) {
        std::string text =
                "# Generated by: MATCH_GOLDEN=<dir> pio test -e native\n";
        for (const auto &r : results)
            text += r.name + "\t" + std::to_string(r.start) + "\t" + r.marks +
                    "\n";
        writeZst(std::string(out) + "/" + file, text);
        return;
    }
    const auto golden = records(dir + file);
    TEST_ASSERT_EQUAL_MESSAGE(golden.size(), results.size(), file.c_str());
    unsigned failures = 0;
    for (size_t i = 0; i < golden.size(); ++i) {
        const auto &g = golden[i];
        const auto &r = results[i];
        if (g.size() == 3 && r.name == g[0] &&
                std::to_string(r.start) == g[1] && r.marks == g[2])
            continue;
        if (failures++ < 10)
            printf("%s: start %d marks %s, golden %s: start %s marks %s\n",
                    r.name.c_str(), r.start, r.marks.c_str(), g[0].c_str(),
                    g.size() > 1 ? g[1].c_str() : "?",
                    g.size() > 2 ? g[2].c_str() : "?");
    }
    TEST_ASSERT_EQUAL_MESSAGE(0, failures, file.c_str());
}

// How many runs the profile image marked unlike they do on the host, with
// |mark| turning a raw mark into what the image printed: the recording's
// runs were trimmed, so this is only a report. |trap| skips the last mark
// recorded, the trap's fetch, which only its trimmed cycles confirmed.
template <typename REPLAY>
void report(const std::vector<Ring> &rings, REPLAY replay, int (*mark)(int),
        bool trap = false) {
    unsigned differ = 0;
    for (const auto &r : rings) {
        std::vector<int> marks;
        replayOf(replay, r.cycles, marks, r.stop);
        size_t last = 0;
        for (size_t i = 0; i < r.cycles.size(); ++i) {
            if (r.cycles[i].mark)
                last = i;
        }
        for (size_t i = 0; i < r.cycles.size(); ++i) {
            if (trap && i == last && last > 0)
                continue;
            if (r.cycles[i].mark != mark(marks[i])) {
                ++differ;
                break;
            }
        }
    }
    printf("%u of %zu runs marked unlike the recording\n", differ,
            rings.size());
}

}  // namespace match_harness

#endif

// Local Variables:
// mode: c++
// c-basic-offset: 4
// tab-width: 4
// End:
// vim: set ft=cpp et ts=4 sw=4:
